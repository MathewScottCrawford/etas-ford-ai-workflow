AUTOSAR XML (schema 00048)
# License: MIT
package /EcuInstance
  ecu instance ECU_Powertrain
    com controller CAN_Controller_0
package /COM_Config
  i signal EngineSpeed_Sig: length=16, init-value=0, transfer-property=TRIGGERED
  i signal VehicleSpeed_Sig: length=16, init-value=0, transfer-property=TRIGGERED
  i signal ThrottlePosition_Sig: length=8, init-value=0, transfer-property=TRIGGERED
  i pdu PT_Status_PDU: length=8
    pdu to frame mapping PT_Status_Mapping
  i pdu Engine_Control_PDU: length=8
    pdu to frame mapping Engine_Control_Mapping
package /OS_Config
  os application OsApp_Powertrain: trusted=true
  task OsTask_10ms: priority=5, period=10, activation=1, stack-size=512
  task OsTask_100ms: priority=3, period=100, activation=1, stack-size=512
package /DCM_Config
  diagnostic data identifier DID_0xF190: identifier=61840, data-length=17
  diagnostic data identifier DID_0xF187: identifier=61831, data-length=10
  diagnostic session DefaultSession: session-level=1
  diagnostic session ProgrammingSession: session-level=2
