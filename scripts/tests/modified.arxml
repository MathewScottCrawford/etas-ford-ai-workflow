AUTOSAR XML (schema 00048)
# License: MIT
package /EcuInstance
  ecu instance ECU_Powertrain
    com controller CAN_Controller_0
    com controller CAN_Controller_1
package /COM_Config
  4 x i signal, all with init-value=0:
    EngineSpeed_Sig: length=32, transfer-property=TRIGGERED
    VehicleSpeed_Sig: length=16, transfer-property=PENDING
    ThrottlePosition_Sig: length=8, transfer-property=TRIGGERED
    BrakePressure_Sig: length=16, transfer-property=TRIGGERED
  i pdu PT_Status_PDU: length=16
    pdu to frame mapping PT_Status_Mapping
  i pdu Engine_Control_PDU: length=8
    pdu to frame mapping Engine_Control_Mapping
  i pdu Brake_Status_PDU: length=8
    pdu to frame mapping Brake_Status_Mapping
package /OS_Config
  os application OsApp_Powertrain: trusted=true
  task OsTask_10ms: priority=7, period=10, activation=1, stack-size=512
  task OsTask_100ms: priority=3, period=100, activation=1, stack-size=1024
  task OsTask_5ms: priority=9, period=5, activation=1, stack-size=256
package /DCM_Config
  diagnostic data identifier DID_0xF190: identifier=61840, data-length=17
  diagnostic data identifier DID_0xF187: identifier=61831, data-length=14
  diagnostic data identifier DID_0xF101: identifier=61697, data-length=4
  diagnostic session DefaultSession: session-level=1
  diagnostic session ExtendedDiagnosticSession: session-level=3
